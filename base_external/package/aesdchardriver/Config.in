## base_external/package/aesdchardriver/Config.in
```kconfig
config BR2_PACKAGE_AESDCHARDRIVER
	bool "aesdchardriver"
	help
	  AESD character driver for assignment 8 
```

## base_external/package/ldd/Config.in
```kconfig
config BR2_PACKAGE_LDD
	bool "ldd"
	select BR2_LINUX_KERNEL
	help
	  assignment7 ldd to add to buildroot trees and package builds
```
